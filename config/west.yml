## config/west.yml
```yaml
manifest:
  remotes:
    - name: zmkfirmware
      url-base: https://github.com/zmkfirmware
    - name: refil
      url-base: https://github.com/refil
    - name: unsyned
      url-base: https://github.com/unsyned
  projects:
    - name: zmk
      remote: refil
      revision: adv360-z3.5-2
      import: app/west.yml
    - name: zmk-userspace # for persistent default layer
      # remote: elpekenin
      # revision: main
      remote: unsyned
      revision: v0.3
  self:
    path: config
```
